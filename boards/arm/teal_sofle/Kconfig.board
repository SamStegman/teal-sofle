## boards/arm/teal_sofle/Kconfig.board
```kconfig
#
# Copyright (c) 2024 The ZMK Contributors
# SPDX-License-Identifier: MIT
#

config BOARD_TEAL_SOFLE_LEFT
    bool "teal_sofle left"
    depends on SOC_NRF52840_QIAA

config BOARD_TEAL_SOFLE_RIGHT
    bool "teal_sofle right"
    depends on SOC_NRF52840_QIAA
```
